## conf/layer.conf
```bitbake
# We have a conf and classes directory, add to BBPATH
BBPATH .= ":${LAYERDIR}"

# We have recipes-* directories, add to BBFILES
BBFILES += "${LAYERDIR}/recipes-*/*/*.bb \
            ${LAYERDIR}/recipes-*/*/*.bbappend \
"

BBFILE_COLLECTIONS += "headunit"
BBFILE_PATTERN_headunit = "^${LAYERDIR}/"
BBFILE_PRIORITY_headunit = "15"

LAYERDEPENDS_meta-env = "core"
LAYERSERIES_COMPAT_headunit = "kirkstone"

LICENSE_FLAGS_ACCEPTED += "commercial"
```
